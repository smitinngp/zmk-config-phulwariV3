## boards/shields/phulwariv3/Kconfig.defconfig
```kconfig
if SHIELD_PHULWARIV3_LEFT

# Name must be less than 16 characters long!
config ZMK_KEYBOARD_NAME
    default "PhulwariV3"

config ZMK_SPLIT_ROLE_CENTRAL
    default y

endif

if SHIELD_PHULWARIV3_LEFT || SHIELD_PHULWARIV3_RIGHT

config ZMK_SPLIT
    default y

endif

# ---------------------
# Kconfig for shield "phulwariv3_left" with board "nice_nano_v2"
# ---------------------
if BOARD_NICE_NANO_V2 && SHIELD_PHULWARIV3_LEFT

config I2C
    default y

config ZMK_DISPLAY
    default y

if ZMK_DISPLAY

config I2C
    default y

config SSD1306
    default y

endif # ZMK_DISPLAY

if LVGL

config LV_Z_VDB_SIZE
    default 64

config LV_DPI_DEF
    default 148

config LV_Z_BITS_PER_PIXEL
    default 1

choice LV_COLOR_DEPTH
    default LV_COLOR_DEPTH_1
endchoice

endif # LVGL

endif

# ---------------------
# Kconfig for shield "phulwariv3_right" with board "nice_nano_v2"
# ---------------------
if BOARD_NICE_NANO_V2 && SHIELD_PHULWARIV3_RIGHT

config I2C
    default y

config ZMK_DISPLAY
    default y

if ZMK_DISPLAY

config I2C
    default y

config SSD1306
    default y

endif # ZMK_DISPLAY

if LVGL

config LV_Z_VDB_SIZE
    default 64

config LV_DPI_DEF
    default 148

config LV_Z_BITS_PER_PIXEL
    default 1

choice LV_COLOR_DEPTH
    default LV_COLOR_DEPTH_1
endchoice

endif # LVGL

endif
```

## boards/shields/phulwariv3/Kconfig.shield
```kconfig
config SHIELD_PHULWARIV3_LEFT
    def_bool $(shields_list_contains,phulwariv3_left)
  
config SHIELD_PHULWARIV3_RIGHT
    def_bool $(shields_list_contains,phulwariv3_right)
  
```
